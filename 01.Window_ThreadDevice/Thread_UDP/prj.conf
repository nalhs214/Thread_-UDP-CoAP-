## CMakeLists.txt
```
cmake_minimum_required(VERSION 3.20.0)
find_package(Zephyr REQUIRED HINTS $ENV{ZEPHYR_BASE})

project(Thread_UDP)

target_sources(app PRIVATE
    src/main.c
    src/app/app_main.c
    src/app/app_fsm.c
    src/app/app_btn.c
    src/app/app_led.c
    src/thread/thread.c
    src/udp/udp.c
)

# 모듈 헤더(inc/)를 bare-name(#include "xxx.h")으로 include 하기 위한 경로
target_include_directories(app PRIVATE
    inc/app
    inc/thread
    inc/udp
)
```

## prj.conf
```kconfig
# ── Thread / OpenThread ──────────────────────────
CONFIG_NET_L2_OPENTHREAD=y
CONFIG_OPENTHREAD_FTD=y
# 네트워크를 코드에서 직접 시작 (CLI 미사용)
CONFIG_OPENTHREAD_MANUAL_START=y

# ── 네트워킹 (IPv6 / UDP / BSD 소켓) ─────────────
CONFIG_NETWORKING=y
CONFIG_NET_IPV6=y
CONFIG_NET_UDP=y
# UDP 모듈을 Zephyr BSD 소켓(zsock_*)으로 구현하기 위함
CONFIG_NET_SOCKETS=y

# CoAP 단계에서 추가
# CONFIG_COAP=y

# ── DK 라이브러리 (버튼 / LED) ───────────────────
CONFIG_DK_LIBRARY=y
CONFIG_GPIO=y

# ── 로깅 ─────────────────────────────────────────
CONFIG_PRINTK=y
CONFIG_LOG=y
CONFIG_LOG_DEFAULT_LEVEL=3
CONFIG_OPENTHREAD_LOG_LEVEL_INFO=y
CONFIG_THREAD_NAME=y

# ── 스택 크기 ────────────────────────────────────
CONFIG_MAIN_STACK_SIZE=4096
CONFIG_SYSTEM_WORKQUEUE_STACK_SIZE=4096
```

## src/main.c
```c
/* ===========================================================================
 * main.c  —  진입점
 *
 *   초기화는 전부 app_init() 에 위임한다.
 *   이후 모든 동작은 Work Queue / OpenThread 스레드에서 이벤트 기반으로
 *   진행되므로, main 스레드는 할 일이 없어 영원히 잠든다.
 * ========================================================================= */

#include "app_main.h"

#include <zephyr/kernel.h>
#include <zephyr/logging/log.h>

LOG_MODULE_REGISTER(main, LOG_LEVEL_INF);

int main(void)
{
    int err = app_init();
    if (err) {
        LOG_ERR("app_init failed: %d", err);
        return err;
    }

    /* main 스레드는 더 이상 할 일이 없다.
     * (실제 로직은 app_wq / OpenThread 스레드에서 이벤트로 처리) */
    while (1) {
        k_sleep(K_FOREVER);
    }

    return 0;
}
```
